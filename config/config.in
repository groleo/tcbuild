## toolchain/arch/arm/config.in
```kconfig
# ARM specific configuration file

config ARCH_arm
    select ARCH_SUPPORTS_BOTH_ENDIAN
    select ARCH_DEFAULT_LE
    select ARCH_SUPPORT_ARCH
    select ARCH_SUPPORT_CPU
    select ARCH_SUPPORT_TUNE
    select ARCH_SUPPORT_FPU
    help
      The ARM architecture, as defined by:
        http://www.arm.com/

config ARCH_ARM_EABI
    bool
    prompt "Use EABI"
    default n
    help
      Set up the toolchain so that it generates EABI-compliant binaries.

config ARCH_ARM_ABI_OK
    bool
    default y
    depends on ! ARCH_ARM_EABI
    select ARCH_SUPPORT_ABI

choice
    bool
    prompt "CPU Type"

config ARCH_arm_arm1
    bool
    prompt "arm1"

config ARCH_arm_arm2
    bool
    prompt "arm2"

config ARCH_arm_arm250
    bool
    prompt "arm250"

config ARCH_arm_arm3
    bool
    prompt "arm3"

config ARCH_arm_arm6
    bool
    prompt "arm6"

config ARCH_arm_arm600
    bool
    prompt "arm600"

config ARCH_arm_arm610
    bool
    prompt "arm610"

config ARCH_arm_arm620
    bool
    prompt "arm620"

config ARCH_arm_arm7
    bool
    prompt "arm7"

config ARCH_arm_arm70
    bool
    prompt "arm70"

config ARCH_arm_arm700
    bool
    prompt "arm700"

config ARCH_arm_arm700i
    bool
    prompt "arm700i"

config ARCH_arm_arm710
    bool
    prompt "arm710"

config ARCH_arm_arm7100
    bool
    prompt "arm7100"

config ARCH_arm_arm710c
    bool
    prompt "arm710c"

config ARCH_arm_arm710t
    bool
    prompt "arm710t"

config ARCH_arm_arm720
    bool
    prompt "arm720"

config ARCH_arm_arm720t
    bool
    prompt "arm720t"

config ARCH_arm_arm740t
    bool
    prompt "arm740t"

config ARCH_arm_arm7500
    bool
    prompt "arm7500"

config ARCH_arm_arm7500fe
    bool
    prompt "arm7500fe"

config ARCH_arm_arm7d
    bool
    prompt "arm7d"

config ARCH_arm_arm7di
    bool
    prompt "arm7di"

config ARCH_arm_arm7dm
    bool
    prompt "arm7dm"

config ARCH_arm_arm7dmi
    bool
    prompt "arm7dmi"

config ARCH_arm_arm7m
    bool
    prompt "arm7m"

config ARCH_arm_arm7tdmi
    bool
    prompt "arm7tdmi"

config ARCH_arm_arm8
    bool
    prompt "arm8"

config ARCH_arm_arm810
    bool
    prompt "arm810"

config ARCH_arm_arm9
    bool
    prompt "arm9"

config ARCH_arm_arm920
    bool
    prompt "arm920"

config ARCH_arm_arm940
    bool
    prompt "arm940"

config ARCH_arm_arm9tdmi
    bool
    prompt "arm9tdmi"

config ARCH_arm_strongarm
    bool
    prompt "strongarm"

endchoice


########
config ARCH_CPU
    string
    default "arm1" if ARCH_arm_arm1
    default "arm2" if ARCH_arm_arm2
    default "arm250" if ARCH_arm_arm250
    default "arm3" if ARCH_arm_arm3
    default "arm6" if ARCH_arm_arm6
    default "arm600" if ARCH_arm_arm600
    default "arm610" if ARCH_arm_arm610
    default "arm620" if ARCH_arm_arm620
    default "arm7" if ARCH_arm_arm7
    default "arm70" if ARCH_arm_arm70
    default "arm700" if ARCH_arm_arm700
    default "arm700i" if ARCH_arm_arm700i
    default "arm710" if ARCH_arm_arm710
    default "arm7100" if ARCH_arm_arm7100
    default "arm710c" if ARCH_arm_arm710c
    default "arm710t" if ARCH_arm_arm710t
    default "arm720" if ARCH_arm_arm720
    default "arm720t" if ARCH_arm_arm720t
    default "arm740t" if ARCH_arm_arm740t
    default "arm7500" if ARCH_arm_arm7500
    default "arm7500fe" if ARCH_arm_arm7500fe
    default "arm7d" if ARCH_arm_arm7d
    default "arm7di" if ARCH_arm_arm7di
    default "arm7dm" if ARCH_arm_arm7dm
    default "arm7dmi" if ARCH_arm_arm7dmi
    default "arm7m" if ARCH_arm_arm7m
    default "arm7tdmi" if ARCH_arm_arm7tdmi
    default "arm8" if ARCH_arm_arm8
    default "arm810" if ARCH_arm_arm810
    default "arm9" if ARCH_arm_arm9
    default "arm920" if ARCH_arm_arm920
    default "arm940" if ARCH_arm_arm940
    default "arm9tdmi" if ARCH_arm_arm9tdmi
    default "strongarm" if ARCH_arm_strongarm
```

## toolchain/arch/m68k/config.in
```kconfig
# m68k specific options

config ARCH_m68k
    select ARCH_SUPPORT_ARCH
    select ARCH_SUPPORT_CPU
    select ARCH_SUPPORT_TUNE
    help
      The m68k architecture, as defined by.

########
choice
    bool
    prompt "CPU Type"


config ARCH_m68k_51
    bool
    prompt "51"

config ARCH_m68k_51ac
    bool
    prompt "51ac"

config ARCH_m68k_51cn
    bool
    prompt "51cn"

config ARCH_m68k_51em
    bool
    prompt "51em"

config ARCH_m68k_51qe
    bool
    prompt "51qe"

config ARCH_m68k_5202
    bool
    prompt "5202"

config ARCH_m68k_5204
    bool
    prompt "5204"

config ARCH_m68k_5206
    bool
    prompt "5206"

config ARCH_m68k_5206e
    bool
    prompt "5206e"

config ARCH_m68k_5207
    bool
    prompt "5207"

config ARCH_m68k_5208
    bool
    prompt "5208"

config ARCH_m68k_5210a
    bool
    prompt "5210a"

config ARCH_m68k_5211a
    bool
    prompt "5211a"

config ARCH_m68k_5211
    bool
    prompt "5211"

config ARCH_m68k_5212
    bool
    prompt "5212"

config ARCH_m68k_5213
    bool
    prompt "5213"

config ARCH_m68k_5214
    bool
    prompt "5214"

config ARCH_m68k_5216
    bool
    prompt "5216"

config ARCH_m68k_52230
    bool
    prompt "52230"

config ARCH_m68k_52231
    bool
    prompt "52231"

config ARCH_m68k_52232
    bool
    prompt "52232"

config ARCH_m68k_52233
    bool
    prompt "52233"

config ARCH_m68k_52234
    bool
    prompt "52234"

config ARCH_m68k_52235
    bool
    prompt "52235"

config ARCH_m68k_5224
    bool
    prompt "5224"

config ARCH_m68k_5225
    bool
    prompt "5225"

config ARCH_m68k_52252
    bool
    prompt "52252"

config ARCH_m68k_52254
    bool
    prompt "52254"

config ARCH_m68k_52255
    bool
    prompt "52255"

config ARCH_m68k_52256
    bool
    prompt "52256"

config ARCH_m68k_52258
    bool
    prompt "52258"

config ARCH_m68k_52259
    bool
    prompt "52259"

config ARCH_m68k_5232
    bool
    prompt "5232"

config ARCH_m68k_5233
    bool
    prompt "5233"

config ARCH_m68k_5234
    bool
    prompt "5234"

config ARCH_m68k_5235
    bool
    prompt "5235"

config ARCH_m68k_523x
    bool
    prompt "523x"

config ARCH_m68k_5249
    bool
    prompt "5249"

config ARCH_m68k_5250
    bool
    prompt "5250"

config ARCH_m68k_5270
    bool
    prompt "5270"

config ARCH_m68k_5271
    bool
    prompt "5271"

config ARCH_m68k_5272
    bool
    prompt "5272"

config ARCH_m68k_5274
    bool
    prompt "5274"

config ARCH_m68k_5275
    bool
    prompt "5275"

config ARCH_m68k_5280
    bool
    prompt "5280"

config ARCH_m68k_5281
    bool
    prompt "5281"

config ARCH_m68k_5282
    bool
    prompt "5282"

config ARCH_m68k_528x
    bool
    prompt "528x"

config ARCH_m68k_53011
    bool
    prompt "53011"

config ARCH_m68k_53012
    bool
    prompt "53012"

config ARCH_m68k_53013
    bool
    prompt "53013"

config ARCH_m68k_53014
    bool
    prompt "53014"

config ARCH_m68k_53015
    bool
    prompt "53015"

config ARCH_m68k_53016
    bool
    prompt "53016"

config ARCH_m68k_53017
    bool
    prompt "53017"

config ARCH_m68k_5307
    bool
    prompt "5307"

config ARCH_m68k_5327
    bool
    prompt "5327"

config ARCH_m68k_5328
    bool
    prompt "5328"

config ARCH_m68k_5329
    bool
    prompt "5329"

config ARCH_m68k_532x
    bool
    prompt "532x"

config ARCH_m68k_5372
    bool
    prompt "5372"

config ARCH_m68k_5373
    bool
    prompt "5373"

config ARCH_m68k_537x
    bool
    prompt "537x"

config ARCH_m68k_5407
    bool
    prompt "5407"

config ARCH_m68k_5470
    bool
    prompt "5470"

config ARCH_m68k_5471
    bool
    prompt "5471"

config ARCH_m68k_5472
    bool
    prompt "5472"

config ARCH_m68k_5473
    bool
    prompt "5473"

config ARCH_m68k_5474
    bool
    prompt "5474"

config ARCH_m68k_5475
    bool
    prompt "5475"

config ARCH_m68k_547x
    bool
    prompt "547x"

config ARCH_m68k_5480
    bool
    prompt "5480"

config ARCH_m68k_5481
    bool
    prompt "5481"

config ARCH_m68k_5482
    bool
    prompt "5482"

config ARCH_m68k_5483
    bool
    prompt "5483"

config ARCH_m68k_5484
    bool
    prompt "5484"

config ARCH_m68k_5485
    bool
    prompt "5485"
endchoice

########
config ARCH_CPU
    string
    default "5475"   if ARCH_m68k_5475
    default "5485"   if ARCH_m68k_5485
    default "51" if ARCH_m68k_51
    default "51ac" if ARCH_m68k_51ac
    default "51cn" if ARCH_m68k_51cn
    default "51em" if ARCH_m68k_51em
    default "51qe" if ARCH_m68k_51qe
    default "5202" if ARCH_m68k_5202
    default "5204" if ARCH_m68k_5204
    default "5206" if ARCH_m68k_5206
    default "5206e" if ARCH_m68k_5206e
    default "5207" if ARCH_m68k_5207
    default "5208" if ARCH_m68k_5208
    default "5210a" if ARCH_m68k_5210a
    default "5211a" if ARCH_m68k_5211a
    default "5211" if ARCH_m68k_5211
    default "5212" if ARCH_m68k_5212
    default "5213" if ARCH_m68k_5213
    default "5214" if ARCH_m68k_5214
    default "5216" if ARCH_m68k_5216
    default "52230" if ARCH_m68k_52230
    default "52231" if ARCH_m68k_52231
    default "52232" if ARCH_m68k_52232
    default "52233" if ARCH_m68k_52233
    default "52234" if ARCH_m68k_52234
    default "52235" if ARCH_m68k_52235
    default "5224" if ARCH_m68k_5224
    default "5225" if ARCH_m68k_5225
    default "52252" if ARCH_m68k_52252
    default "52254" if ARCH_m68k_52254
    default "52255" if ARCH_m68k_52255
    default "52256" if ARCH_m68k_52256
    default "52258" if ARCH_m68k_52258
    default "52259" if ARCH_m68k_52259
    default "5232" if ARCH_m68k_5232
    default "5233" if ARCH_m68k_5233
    default "5234" if ARCH_m68k_5234
    default "5235" if ARCH_m68k_5235
    default "523x" if ARCH_m68k_523x
    default "5249" if ARCH_m68k_5249
    default "5250" if ARCH_m68k_5250
    default "5270" if ARCH_m68k_5270
    default "5271" if ARCH_m68k_5271
    default "5272" if ARCH_m68k_5272
    default "5274" if ARCH_m68k_5274
    default "5275" if ARCH_m68k_5275
    default "5280" if ARCH_m68k_5280
    default "5281" if ARCH_m68k_5281
    default "5282" if ARCH_m68k_5282
    default "528x" if ARCH_m68k_528x
    default "53011" if ARCH_m68k_53011
    default "53012" if ARCH_m68k_53012
    default "53013" if ARCH_m68k_53013
    default "53014" if ARCH_m68k_53014
    default "53015" if ARCH_m68k_53015
    default "53016" if ARCH_m68k_53016
    default "53017" if ARCH_m68k_53017
    default "5307" if ARCH_m68k_5307
    default "5327" if ARCH_m68k_5327
    default "5328" if ARCH_m68k_5328
    default "5329" if ARCH_m68k_5329
    default "532x" if ARCH_m68k_532x
    default "5372" if ARCH_m68k_5372
    default "5373" if ARCH_m68k_5373
    default "537x" if ARCH_m68k_537x
    default "5407" if ARCH_m68k_5407
    default "5470" if ARCH_m68k_5470
    default "5471" if ARCH_m68k_5471
    default "5472" if ARCH_m68k_5472
    default "5473" if ARCH_m68k_5473
    default "5474" if ARCH_m68k_5474
    default "5475" if ARCH_m68k_5475
    default "547x" if ARCH_m68k_547x
    default "5480" if ARCH_m68k_5480
    default "5481" if ARCH_m68k_5481
    default "5482" if ARCH_m68k_5482
    default "5483" if ARCH_m68k_5483
    default "5484" if ARCH_m68k_5484
    default "5485" if ARCH_m68k_5485
```

## toolchain/arch/mips/config.in
```kconfig
# MIPS specific config options

config ARCH_mips
    select ARCH_SUPPORTS_BOTH_ENDIAN
    select ARCH_DEFAULT_BE
    select ARCH_SUPPORT_ARCH
    select ARCH_SUPPORT_ABI
    select ARCH_SUPPORT_TUNE
    help
      The MIPS architecture, as defined by:
        http://www.mips.com/


########
choice
    bool
    prompt "Variant"

config ARCH_mips_4kc
    bool
    prompt "4kc"

config ARCH_mips_4km
    bool
    prompt "4km"

config ARCH_mips_4kp
    bool
    prompt "4kp"

config ARCH_mips_4ksc
    bool
    prompt "4ksc"

config ARCH_mips_4kec
    bool
    prompt "4kec"

config ARCH_mips_4kem
    bool
    prompt "4kem"

config ARCH_mips_4kep
    bool
    prompt "4kep"

config ARCH_mips_4ksd
    bool
    prompt "4ksd"

config ARCH_mips_5kc
    bool
    prompt "5kc"

config ARCH_mips_5kf
    bool
    prompt "5kf"

config ARCH_mips_20kc
    bool
    prompt "20kc"

config ARCH_mips_24kc
    bool
    prompt "24kc"

config ARCH_mips_24kf2_1
    bool
    prompt "24kf2_1"

config ARCH_mips_24kf1_1
    bool
    prompt "24kf1_1"

config ARCH_mips_24kec
    bool
    prompt "24kec"

config ARCH_mips_24kef2_1
    bool
    prompt "24kef2_1"

config ARCH_mips_24kef1_1
    bool
    prompt "24kef1_1"

config ARCH_mips_34kc
    bool
    prompt "34kc"

config ARCH_mips_34kf2_1
    bool
    prompt "34kf2_1"

config ARCH_mips_34kf1_1
    bool
    prompt "34kf1_1"

config ARCH_mips_74kc
    bool
    prompt "74kc"

config ARCH_mips_74kf2_1
    bool
    prompt "74kf2_1"

config ARCH_mips_74kf1_1
    bool
    prompt "74kf1_1"

config ARCH_mips_74kf3_2
    bool
    prompt "74kf3_2"

config ARCH_mips_loongson2e
    bool
    prompt "loongson2e"

config ARCH_mips_loongson2f
    bool
    prompt "loongson2f"

config ARCH_mips_m4k
    bool
    prompt "m4k"

config ARCH_mips_octeon
    bool
    prompt "octeon"

config ARCH_mips_orion
    bool
    prompt "orion"

config ARCH_mips_r2000
    bool
    prompt "r2000"

config ARCH_mips_r3000
    bool
    prompt "r3000"

config ARCH_mips_r3900
    bool
    prompt "r3900"

config ARCH_mips_r4000
    bool
    prompt "r4000"

config ARCH_mips_r4400
    bool
    prompt "r4400"

config ARCH_mips_r4600
    bool
    prompt "r4600"

config ARCH_mips_r4650
    bool
    prompt "r4650"

config ARCH_mips_r6000
    bool
    prompt "r6000"

config ARCH_mips_r8000
    bool
    prompt "r8000"

config ARCH_mips_rm7000
    bool
    prompt "rm7000"

config ARCH_mips_rm9000
    bool
    prompt "rm9000"

config ARCH_mips_r10000
    bool
    prompt "r10000"

config ARCH_mips_r12000
    bool
    prompt "r12000"

config ARCH_mips_r14000
    bool
    prompt "r14000"

config ARCH_mips_r16000
    bool
    prompt "r16000"

config ARCH_mips_sb1
    bool
    prompt "sb1"

config ARCH_mips_sr71000
    bool
    prompt "sr71000"

config ARCH_mips_vr4100
    bool
    prompt "vr4100"

config ARCH_mips_vr4111
    bool
    prompt "vr4111"

config ARCH_mips_vr4120
    bool
    prompt "vr4120"

config ARCH_mips_vr4130
    bool
    prompt "vr4130"

config ARCH_mips_vr4300
    bool
    prompt "vr4300"

config ARCH_mips_vr5000
    bool
    prompt "vr5000"

config ARCH_mips_vr5400
    bool
    prompt "vr5400"

config ARCH_mips_vr5500
    bool
    prompt "vr5500"

config ARCH_mips_and
    bool
    prompt "and"

config ARCH_mips_xlr
    bool
    prompt "xlr"
endchoice
```

## toolchain/cloog-ppl/config.in
```kconfig
# CLOOG options

config CLOOG_PPL
    string
    default "cloog-ppl" if CC_GCC_4_4_or_later

choice
    bool
    prompt "CLOOG version"

config CLOOG_PPL_V_0_15_3
    bool
    prompt "0.15.3"
config CLOOG_PPL_V_0_15_7
    bool
    prompt "0.15.7"


# CT_INSERT_VERSION_ABOVE
# Don't remove above line!
endchoice

config CLOOG_PPL_VERSION
    string
    default "0.15.3" if CLOOG_PPL_V_0_15_3
    default "0.15.7" if CLOOG_PPL_V_0_15_7

# CT_INSERT_VERSION_STRING_ABOVE
# Don't remove above line!

config CLOOG_PPL_CHECK
    bool
    prompt "Check CLOOG_PPL"
    default y
    help
      It is highly recommended that 'make check' is run against the newly built
      CLOOG library.
```
