## config/config.in
```kconfig
source config/_arch.in
 source config/_libc.in
 source config/_compiler.in
 source config/_cloog-ppl.in
 source config/_ppl.in
 source config/_mpfr.in
 source config/_gmp.in
 source config/_kernel.in
 source config/_binutils.in
 source config/_packages.in

source config/toolchain.in
source config/global.in
```

## packages/axTLS/config.in
```kconfig
config AXTLS
    string

choice
    bool
    prompt "Version"


config AXTLS_V_1_2_2
    bool
    prompt "1.2.2"

# CT_INSERT_VERSION_ABOVE
# Don't remove above line!

config AXTLS_V_snapshot
    bool
    prompt "latest snapshot (EXPERIMENTAL)"
    depends on EXPERIMENTAL

config AXTLS_V_specific_date
    bool
    prompt "<specific date> (EXPERIMENTAL)"
    depends on EXPERIMENTAL

endchoice

config AXTLS_VERSION
    string
    prompt "Enter date (YYYYMMDD)" if AXTLS_V_specific_date
    default "snapshot" if AXTLS_V_snapshot
    default "1.2.2" if AXTLS_V_1_2_2

# CT_INSERT_VERSION_STRING_ABOVE
# Don't remove above line!

config AXTLS_CONFIG_FILE
    string
    prompt "Configuration file"
    default "${CT_PKG_DIR}/axTLS/axTLS.config"
    help
      Path to the configuration file.
      Default is "${CT_PKG_DIR}/axTLS/axTLS.config"
      You _must_ provide one (for now).
```

## packages/busybox/config.in
```kconfig
# busybox options
config BUSYBOX
    string

choice
    bool
    prompt "Version"


config BUSYBOX_V_1_13_3
    bool
    prompt "1.13.3"

config BUSYBOX_V_1_13_4
    bool
    prompt "1.13.4"

config BUSYBOX_V_1_14_0
    bool
    prompt "1.14.0"

config BUSYBOX_V_1_14_1
    bool
    prompt "1.14.1"

config BUSYBOX_V_1_14_2
    bool
    prompt "1.14.2"

config BUSYBOX_V_1_14_3
    bool
    prompt "1.14.3"


# CT_INSERT_VERSION_ABOVE
# Don't remove above line!

config BUSYBOX_V_snapshot
    bool
    prompt "latest snapshot (EXPERIMENTAL)"
    depends on EXPERIMENTAL

config BUSYBOX_V_specific_date
    bool
    prompt "<specific date> (EXPERIMENTAL)"
    depends on EXPERIMENTAL

endchoice

config BUSYBOX_VERSION
    string
    prompt "Enter date (YYYYMMDD)" if BUSYBOX_V_specific_date
    default "snapshot" if BUSYBOX_V_snapshot
    default "1.13.3" if BUSYBOX_V_1_13_3
    default "1.13.4" if BUSYBOX_V_1_13_4
    default "1.14.0" if BUSYBOX_V_1_14_0
    default "1.14.1" if BUSYBOX_V_1_14_1
    default "1.14.2" if BUSYBOX_V_1_14_2

# CT_INSERT_VERSION_STRING_ABOVE
# Don't remove above line!


choice
    bool
    prompt "Busybox verbosity:"
    default BUSYBOX_VERBOSITY_0

config BUSYBOX_VERBOSITY_0
    bool
    prompt "Simplified"
    help
      Print simplified command lines.

config BUSYBOX_VERBOSITY_1
    bool
    prompt "Full commands"
    help
      Print full command lines.

endchoice

config BUSYBOX_VERBOSITY
    string
    default ""      if BUSYBOX_VERBOSITY_0
    default "V=1"   if BUSYBOX_VERBOSITY_1

choice
    bool
    prompt "Debug level"
    default BUSYBOX_DEBUG_LEVEL_0

config BUSYBOX_DEBUG_LEVEL_0
    bool
    prompt "none"

config BUSYBOX_DEBUG_LEVEL_1
    bool
    prompt "minimal"

config BUSYBOX_DEBUG_LEVEL_2
    bool
    prompt "all"

endchoice

config BUSYBOX_DEBUG_LEVEL
    int
    default 0 if BUSYBOX_DEBUG_LEVEL_0
    default 1 if BUSYBOX_DEBUG_LEVEL_1
    default 2 if BUSYBOX_DEBUG_LEVEL_2

config BUSYBOX_CONFIG_FILE
    string
    prompt "Configuration file"
    default "${CT_PKG_DIR}/busybox/${CT_ARCH}/busybox.config"
    help
      Path to the configuration file.
      Default is "${CT_PKG_DIR}/busybox/${CT_ARCH}/busybox.config"
      You _must_ provide one (for now).

config BUSYBOX_RUN_CONFIG
    bool
    prompt "Configuration file"
    default n
    help
       Run make menuconfig for busybox.
```

## packages/dropbear/config.in
```kconfig
config DROPBEAR
    string

choice
    bool
    prompt "Version"


config DROPBEAR_V_0_52
    bool
    prompt "0.52"

# CT_INSERT_VERSION_ABOVE
# Don't remove above line!

config DROPBEAR_V_snapshot
    bool
    prompt "latest snapshot (EXPERIMENTAL)"
    depends on EXPERIMENTAL

config DROPBEAR_V_specific_date
    bool
    prompt "<specific date> (EXPERIMENTAL)"
    depends on EXPERIMENTAL

endchoice

config DROPBEAR_VERSION
    string
    prompt "Enter date (YYYYMMDD)" if DROPBEAR_V_specific_date
    default "snapshot" if DROPBEAR_V_snapshot
    default "0.52" if DROPBEAR_V_0_52

# CT_INSERT_VERSION_STRING_ABOVE
# Don't remove above line!
```

## packages/joe/config.in
```kconfig
config JOE
    string

choice
    bool
    prompt "Version"


config JOE_V_3_7
    bool
    prompt "3.7"

# CT_INSERT_VERSION_ABOVE
# Don't remove above line!

config JOE_V_snapshot
    bool
    prompt "latest snapshot (EXPERIMENTAL)"
    depends on EXPERIMENTAL

config JOE_V_specific_date
    bool
    prompt "<specific date> (EXPERIMENTAL)"
    depends on EXPERIMENTAL

endchoice

config JOE_VERSION
    string
    prompt "Enter date (YYYYMMDD)" if JOE_V_specific_date
    default "snapshot" if JOE_V_snapshot
    default "3.7" if JOE_V_3_7

# CT_INSERT_VERSION_STRING_ABOVE
# Don't remove above line!
```

## packages/lsof/config.in
```kconfig
config LSOF
    string

choice
    bool
    prompt "Version"


config LSOF_V_4_81
    bool
    prompt "4.81"

# CT_INSERT_VERSION_ABOVE
# Don't remove above line!

config LSOF_V_snapshot
    bool
    prompt "latest snapshot (EXPERIMENTAL)"
    depends on EXPERIMENTAL

config LSOF_V_specific_date
    bool
    prompt "<specific date> (EXPERIMENTAL)"
    depends on EXPERIMENTAL

endchoice

config LSOF_VERSION
    string
    prompt "Enter date (YYYYMMDD)" if LSOF_V_specific_date
    default "snapshot" if LSOF_V_snapshot
    default "4.81" if LSOF_V_4_81

# CT_INSERT_VERSION_STRING_ABOVE
# Don't remove above line!
```

## packages/mini-httpd/config.in
```kconfig
config MINIHTTPD
    string

choice
    bool
    prompt "Version"


config MINIHTTPD_V_1_19
    bool
    prompt "1.19"

# CT_INSERT_VERSION_ABOVE
# Don't remove above line!

config MINIHTTPD_V_snapshot
    bool
    prompt "latest snapshot (EXPERIMENTAL)"
    depends on EXPERIMENTAL

config MINIHTTPD_V_specific_date
    bool
    prompt "<specific date> (EXPERIMENTAL)"
    depends on EXPERIMENTAL

endchoice

config MINIHTTPD_VERSION
    string
    prompt "Enter date (YYYYMMDD)" if MINIHTTPD_V_specific_date
    default "snapshot" if MINIHTTPD_V_snapshot
    default "1.19" if MINIHTTPD_V_1_19

# CT_INSERT_VERSION_STRING_ABOVE
# Don't remove above line!
```

## packages/minicom/config.in
```kconfig
config MINICOM
    string

choice
    bool
    prompt "Version"


config MINICOM_V_2_3
    bool
    prompt "2.3"

# CT_INSERT_VERSION_ABOVE
# Don't remove above line!

config MINICOM_V_snapshot
    bool
    prompt "latest snapshot (EXPERIMENTAL)"
    depends on EXPERIMENTAL

config MINICOM_V_specific_date
    bool
    prompt "<specific date> (EXPERIMENTAL)"
    depends on EXPERIMENTAL

endchoice

config MINICOM_VERSION
    string
    prompt "Enter date (YYYYMMDD)" if MINICOM_V_specific_date
    default "snapshot" if MINICOM_V_snapshot
    default "2.3" if MINICOM_V_2_3

# CT_INSERT_VERSION_STRING_ABOVE
# Don't remove above line!
```

## packages/nano/config.in
```kconfig
config NANO
    string

choice
    bool
    prompt "Version"


config NANO_V_2_0_9
    bool
    prompt "2.0.9"

# CT_INSERT_VERSION_ABOVE
# Don't remove above line!

config NANO_V_snapshot
    bool
    prompt "latest snapshot (EXPERIMENTAL)"
    depends on EXPERIMENTAL

config NANO_V_specific_date
    bool
    prompt "<specific date> (EXPERIMENTAL)"
    depends on EXPERIMENTAL

endchoice

config NANO_VERSION
    string
    prompt "Enter date (YYYYMMDD)" if NANO_V_specific_date
    default "snapshot" if NANO_V_snapshot
    default "2.0.9" if NANO_V_2_0_9

# CT_INSERT_VERSION_STRING_ABOVE
# Don't remove above line!
```

## packages/ncurses/config.in
```kconfig
config NCURSES
    string

choice
    bool
    prompt "Version"


config NCURSES_V_5_7
    bool
    prompt "5.7"

# CT_INSERT_VERSION_ABOVE
# Don't remove above line!

config NCURSES_V_snapshot
    bool
    prompt "latest snapshot (EXPERIMENTAL)"
    depends on EXPERIMENTAL

config NCURSES_V_specific_date
    bool
    prompt "<specific date> (EXPERIMENTAL)"
    depends on EXPERIMENTAL

endchoice

config NCURSES_VERSION
    string
    prompt "Enter date (YYYYMMDD)" if NCURSES_V_specific_date
    default "snapshot" if NCURSES_V_snapshot
    default "5.7" if NCURSES_V_5_7

# CT_INSERT_VERSION_STRING_ABOVE
# Don't remove above line!
```

## packages/ntp/config.in
```kconfig
config NTP
    string

choice
    bool
    prompt "Version"


config NTP_V_4_2_4p6
    bool
    prompt "4.2.4p6"

# CT_INSERT_VERSION_ABOVE
# Don't remove above line!

config NTP_V_snapshot
    bool
    prompt "latest snapshot (EXPERIMENTAL)"
    depends on EXPERIMENTAL

config NTP_V_specific_date
    bool
    prompt "<specific date> (EXPERIMENTAL)"
    depends on EXPERIMENTAL

endchoice

config NTP_VERSION
    string
    prompt "Enter date (YYYYMMDD)" if NTP_V_specific_date
    default "snapshot" if NTP_V_snapshot
    default "4.2.4p6" if NTP_V_4_2_4p6

# CT_INSERT_VERSION_STRING_ABOVE
# Don't remove above line!
```

## packages/ntpclient/config.in
```kconfig
config NTPCLIENT
    string

choice
    bool
    prompt "Version"


config NTPCLIENT_V_2007_365
    bool
    prompt "2007-365"

# CT_INSERT_VERSION_ABOVE
# Don't remove above line!

config NTPCLIENT_V_snapshot
    bool
    prompt "latest snapshot (EXPERIMENTAL)"
    depends on EXPERIMENTAL

config NTPCLIENT_V_specific_date
    bool
    prompt "<specific date> (EXPERIMENTAL)"
    depends on EXPERIMENTAL

endchoice

config NTPCLIENT_VERSION
    string
    prompt "Enter date (YYYYMMDD)" if NTPCLIENT_V_specific_date
    default "snapshot" if NTPCLIENT_V_snapshot
    default "2007_365" if NTPCLIENT_V_2007_365

# CT_INSERT_VERSION_STRING_ABOVE
# Don't remove above line!
```

## packages/oprofile/config.in
```kconfig
config OPROFILE
    string

choice
    bool
    prompt "Version"


config OPROFILE_V_0_9_4
    bool
    prompt "0.9.4"

# CT_INSERT_VERSION_ABOVE
# Don't remove above line!

config OPROFILE_V_snapshot
    bool
    prompt "latest snapshot (EXPERIMENTAL)"
    depends on EXPERIMENTAL

config OPROFILE_V_specific_date
    bool
    prompt "<specific date> (EXPERIMENTAL)"
    depends on EXPERIMENTAL

endchoice

config OPROFILE_VERSION
    string
    prompt "Enter date (YYYYMMDD)" if OPROFILE_V_specific_date
    default "snapshot" if OPROFILE_V_snapshot
    default "0.9.4" if OPROFILE_V_0_9_4

# CT_INSERT_VERSION_STRING_ABOVE
# Don't remove above line!
```

## packages/php/config.in
```kconfig
config PHP
    string

choice
    bool
    prompt "Version"


config PHP_V_5_2_10
    bool
    prompt "5.2.10"

# CT_INSERT_VERSION_ABOVE
# Don't remove above line!

config PHP_V_snapshot
    bool
    prompt "latest snapshot (EXPERIMENTAL)"
    depends on EXPERIMENTAL

config PHP_V_specific_date
    bool
    prompt "<specific date> (EXPERIMENTAL)"
    depends on EXPERIMENTAL

endchoice

config PHP_VERSION
    string
    prompt "Enter date (YYYYMMDD)" if PHP_V_specific_date
    default "snapshot" if PHP_V_snapshot
    default "5.2.10" if PHP_V_5_2_10

# CT_INSERT_VERSION_STRING_ABOVE
# Don't remove above line!
```

## packages/popt/config.in
```kconfig
config POPT
    string

choice
    bool
    prompt "Version"


config POPT_V_1_14
    bool
    prompt "1.14"

# CT_INSERT_VERSION_ABOVE
# Don't remove above line!

config POPT_V_snapshot
    bool
    prompt "latest snapshot (EXPERIMENTAL)"
    depends on EXPERIMENTAL

config POPT_V_specific_date
    bool
    prompt "<specific date> (EXPERIMENTAL)"
    depends on EXPERIMENTAL

endchoice

config POPT_VERSION
    string
    prompt "Enter date (YYYYMMDD)" if POPT_V_specific_date
    default "snapshot" if POPT_V_snapshot
    default "1.14" if POPT_V_1_14

# CT_INSERT_VERSION_STRING_ABOVE
# Don't remove above line!
```

## packages/ppp/config.in
```kconfig
config PPP
    string

choice
    bool
    prompt "Version"


config PPP_V_2_4_4
    bool
    prompt "2.4.4"

# CT_INSERT_VERSION_ABOVE
# Don't remove above line!

config PPP_V_snapshot
    bool
    prompt "latest snapshot (EXPERIMENTAL)"
    depends on EXPERIMENTAL

config PPP_V_specific_date
    bool
    prompt "<specific date> (EXPERIMENTAL)"
    depends on EXPERIMENTAL

endchoice

config PPP_VERSION
    string
    prompt "Enter date (YYYYMMDD)" if PPP_V_specific_date
    default "snapshot" if PPP_V_snapshot
    default "2.4.4" if PPP_V_2_4_4

# CT_INSERT_VERSION_STRING_ABOVE
# Don't remove above line!
```

## packages/sqlite/config.in
```kconfig
config SQLITE
    string

choice
    bool
    prompt "Version"


config SQLITE_V_3_6_14_2
    bool
    prompt "3.6.14.2"

config SQLITE_V_3_6_20
    bool
    prompt "3.6.20"

# CT_INSERT_VERSION_ABOVE
# Don't remove above line!

config SQLITE_V_snapshot
    bool
    prompt "latest snapshot (EXPERIMENTAL)"
    depends on EXPERIMENTAL

config SQLITE_V_specific_date
    bool
    prompt "<specific date> (EXPERIMENTAL)"
    depends on EXPERIMENTAL

endchoice

config SQLITE_VERSION
    string
    prompt "Enter date (YYYYMMDD)" if SQLITE_V_specific_date
    default "snapshot" if SQLITE_V_snapshot
    default "3.6.14.2" if SQLITE_V_3_6_14_2
    default "3.6.20" if SQLITE_V_3_6_20

# CT_INSERT_VERSION_STRING_ABOVE
# Don't remove above line!
```

## packages/util-linux-ng/config.in
```kconfig
config UTIL_LINUX_NG
    string

choice
    bool
    prompt "Version"


config UTIL_LINUX_NG_V_2_14_2
    bool
    prompt "2.14.2"

# CT_INSERT_VERSION_ABOVE
# Don't remove above line!

config UTIL_LINUX_NG_V_snapshot
    bool
    prompt "latest snapshot (EXPERIMENTAL)"
    depends on EXPERIMENTAL

config UTIL_LINUX_NG_V_specific_date
    bool
    prompt "<specific date> (EXPERIMENTAL)"
    depends on EXPERIMENTAL

endchoice

config UTIL_LINUX_NG_VERSION
    string
    prompt "Enter date (YYYYMMDD)" if UTIL_LINUX_NG_V_specific_date
    default "snapshot" if UTIL_LINUX_NG_V_snapshot
    default "2.14.2" if UTIL_LINUX_NG_V_2_14_2

# CT_INSERT_VERSION_STRING_ABOVE
# Don't remove above line!
```
